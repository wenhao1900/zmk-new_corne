## config/west.yml
```yaml
manifest:
  remotes:
    - name: cormoran
      url-base: https://github.com/cormoran
  projects:
    - name: eyelash_corne
      url: https://github.com/a741725193/zmk-new_corne
      revision: main
    - name: zmk
      remote: cormoran
      # v0.3-branch+custom-studio-protocol+ble
      revision: 6ca2d22692b5b4e3e6b38f2ba4170141755ad6fb
      import: app/west.yml
    - name: zmk-module-ble-management
      remote: cormoran
      revision: 57738cc4fc6ba80e82a7ac57741a0339cb186cd4
  self:
    path: config
```
